## meta-mp3/conf/layer.conf
```bitbake
# We have a conf and classes directory, add to BBPATH
BBPATH .= ":${LAYERDIR}"

# We have recipes-* directories, add to BBFILES
BBFILES += "${LAYERDIR}/recipes-*/*/*.bb \
            ${LAYERDIR}/recipes-*/*/*.bbappend"

BBFILE_COLLECTIONS += "meta-mp3"
BBFILE_PATTERN_meta-mp3 = "^${LAYERDIR}/"
BBFILE_PRIORITY_meta-mp3 = "6"

LAYERDEPENDS_meta-mp3 = "core"
LAYERSERIES_COMPAT_meta-mp3 = "warrior zeus"
```

## meta-mp3/meta-mp3_player/conf/layer.conf
```bitbake
# We have a conf and classes directory, add to BBPATH
BBPATH .= ":${LAYERDIR}"

# We have recipes-* directories, add to BBFILES
BBFILES += "${LAYERDIR}/recipes-*/*/*.bb \
            ${LAYERDIR}/recipes-*/*/*.bbappend"

BBFILE_COLLECTIONS += "meta-mp3_player"
BBFILE_PATTERN_meta-mp3_player = "^${LAYERDIR}/"
BBFILE_PRIORITY_meta-mp3_player = "6"

LAYERDEPENDS_meta-mp3_player = "core"
LAYERSERIES_COMPAT_meta-mp3_player = "warrior zeus"
```
